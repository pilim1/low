#include <behaviors.dtsi>
#include <dt-bindings/zmk/keys.h>
#include <dt-bindings/zmk/bt.h>
#include <dt-bindings/zmk/outputs.h>

/ {
    macros {

    };
    keymap {
        compatible = "zmk,keymap";

        default_layer {
            bindings = <
                &kp C_SLEEP
            >;
            sensor-bindings = <&inc_dec_kp C_VOL_UP C_VOLUME_DOWN>;
        };
    };
};